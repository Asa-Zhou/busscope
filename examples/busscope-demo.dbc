VERSION ""

NS_ :

BS_:

BU_: VCU BMS

BO_ 769 CtrlFrame: 8 VCU
 SG_ CtrlCmd : 0|8@1+ (1,0) [0|255] "" BMS
 SG_ Counter : 32|16@1+ (1,0) [0|65535] "" BMS

BO_ 256 StatusFrame: 8 BMS
 SG_ PackVolt : 0|16@1+ (0.1,0) [0|6553.5] "V" VCU
 SG_ PackCurr : 32|16@1- (0.1,0) [-3276.8|3276.7] "A" VCU

BO_ 513 EchoFrame: 8 BMS
 SG_ EchoId : 0|16@1+ (1,0) [0|65535] "" VCU
 SG_ EchoData : 16|16@1+ (1,0) [0|65535] "" VCU
